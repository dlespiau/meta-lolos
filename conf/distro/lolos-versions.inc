## conf/distro/lolos-versions.inc
```bitbake
PREFERRED_VERSION_mesa-dri-glsl-native = "8.1.0+git%"
#SRCREV_pn-mesa-dri-glsl-native = "${AUTOREV}"

PREFERRED_VERSION_mesa-dri = "8.1.0+git%"
#SRCREV_pn-mesa-dri = "${AUTOREV}"

PREFERRED_VERSION_libdrm = "2.4.37+git%"
#SRCREV_pn-libdrm = "${AUTOREV}"

PREFERRED_VERSION_wayland-native = "0.95.0"
PREFERRED_VERSION_wayland = "0.95.0"
#SRCREV_pn-wayland = "${AUTOREV}"

PREFERRED_VERSION_weston = "0.95.0"
#SRCREV_pn-wayland = "${AUTOREV}"
```

## conf/layer.conf
```bitbake
# We have a conf and classes directory, add to BBPATH
BBPATH := "${LAYERDIR}:${BBPATH}"

# We have a packages directory, add to BBFILES

BBFILES += "${LAYERDIR}/recipes-*/*/*.bb ${LAYERDIR}/recipes-*/*/*.bbappend"

BBFILE_COLLECTIONS += "lolos"
BBFILE_PATTERN_lolos := "^${LAYERDIR}/"
BBFILE_PRIORITY_lolos = "9"
```
